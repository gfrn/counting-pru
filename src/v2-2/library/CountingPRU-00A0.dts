/dts-v1/;
/plugin/;

/ {
        compatible = "ti,beaglebone", "ti,beaglebone-black", "ti,beaglebone-green";

        /* identification */
        part-number = "CountingPRU";
        version = "00A0";

        /* state the resources this cape uses */
        exclusive-use =
                // PRU resources used
                "pruss",
                "pru0",
                "pru1",
                // PRU Input pins
		        	"P8.15","pr1_pru0_pru_r31_15",	// Count1
		        	"P9.24","pr1_pru0_pru_r31_16",	// Count2
		        	"P8.42","pr1_pru1_pru_r31_5",	// Count3
		        	"P8.41","pr1_pru1_pru_r31_4",	// Count4
		        	"P8.40","pr1_pru1_pru_r31_7",	// Count5
		        	"P8.39","pr1_pru1_pru_r31_6",	// Count6
					"P9.30","pr1_pru0_pru_r31_2",	// Count7
					"P9.28","pr1_pru0_pru_r31_3",	// Count8

                // PRU Output pins
					"P8.12","pr1_pru0_pru_r30_5",	// Clear1
					"P9.27","pr1_pru0_pru_r30_14",	// Clear2
					"P8.45","pr1_pru1_pru_r30_0",	// Clear3
					"P8.46","pr1_pru1_pru_r30_1",	// Clear4
					"P8.44","pr1_pru1_pru_r30_3",	// Clear5
					"P8.43","pr1_pru1_pru_r30_2",	// Clear6
					"P9.31","pr1_pru0_pru_r30_0",	// Clear7
					"P9.29 ","pr1_pru0_pru_r30_1";	// Clear8


    // MUX Bit Maps:
    // 0x40 = slow slew (0 = fast slew)
    // 0x20 = input (0 = output)
    // 0x10 = pullup, 0x08 = disabled (0 = pulldown)
    // 0x01 to 0x07 = mode 1 to 7

   fragment@0 {
        target = <&am33xx_pinmux>;
        __overlay__ {
	 pruss_pins: pruss_pins {
                pinctrl-single,pins = <
                    0x03c 0x26	// Input - Pull-down
                    0x184 0x26
                    0x0b4 0x26
                    0x0b0 0x26
                    0x0bc 0x26
                    0x0b8 0x26
                    0x198 0x26
                    0x19c 0x26

                    0x1a4 0x05  // Output
                    0x030 0x06
                    0x0a0 0x05
                    0x0a4 0x05
                    0x0ac 0x05
                    0x0a8 0x05
                    0x190 0x05
                    0x194 0x05

                >;
            };
        };
    };


    fragment@10 {
        target = <&pruss>;
        __overlay__ {
            status = "okay";
            pinctrl-names = "default";
            pinctrl-0     = <&pruss_pins>;
        };
    };
};
